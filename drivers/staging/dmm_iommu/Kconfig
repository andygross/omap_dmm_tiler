## drivers/staging/dmm_iommu/Kconfig
```kconfig
# OMAP DMM IOMMU support
config OMAP_DMM_IOMMU
	tristate "OMAP DMM IOMMU Support"
	depends on ARCH_OMAP4
	default n
	select IOMMU_API
	help
	  Support for the IOMMUs found on OMAP4+ SoCs.  Provides allocation of
	  1D or 2D IOVA address space and pinning and unpinning of memory

	  If unsure, say N here.
```

## drivers/staging/dmm_iommu/test/Kconfig
```kconfig
config OMAP_DMM_TEST
        tristate "OMAP DMM TEST module"
        depends on ARCH_OMAP4
        default n
        help
          Test module for OMAP dmm driver.
```

## drivers/staging/dmm_tiler/Kconfig
```kconfig
# OMAP DMM IOMMU support
config OMAP_DMM_TILER
	tristate "OMAP DMM TILER Support"
	depends on ARCH_OMAP4
	default n
	help
	  Adds support for the DMM TILER found in OMAP4+ SoCs.  The DMM/Tiler
	  provides the capability to create a physically contiguous address
	  from a set of non-contiguous pages of memory.  It also provides
          zero cost rotation for 2D mapped buffers for other OMAP hardware
	  blocks (ISS/DSS).

	  If unsure, say N here.

source "drivers/staging/dmm_tiler/test/Kconfig"
```

## drivers/staging/dmm_tiler/test/Kconfig
```kconfig
config OMAP_DMM_TEST
        tristate "OMAP DMM TEST module"
        depends on OMAP_DMM_TILER
        default n
        help
          Test module for OMAP dmm driver.
```

## drivers/staging/omapdrm/Kconfig
```kconfig
config DRM_OMAP
	tristate "OMAP DRM"
	depends on DRM && !CONFIG_FB_OMAP2
	depends on ARCH_OMAP2PLUS
	default n
	---help---
	  If you want to use the OMAP DRM Display driver and/or
	  DMM/Tiler driver, enable this.

if DRM_OMAP
config DRM_OMAP_DISPLAY
	tristate "OMAP DRM Display driver"
	select DRM_KMS_HELPER
	select OMAP2_DSS
	select FB_SYS_FILLRECT
	select FB_SYS_COPYAREA
	select FB_SYS_IMAGEBLIT
	select FB_SYS_FOPS
	select DRM_OMAP_DMM_TILER
	default y
	---help---
	  DRM display driver for OMAP2/3/4 based boards.

config DRM_OMAP_NUM_CRTCS
	depends on DRM_OMAP_DISPLAY
	int "Number of CRTCs"
	range 1 10
	default 1  if ARCH_OMAP2 || ARCH_OMAP3
	default 2  if ARCH_OMAP4
	depends on DRM_OMAP_DISPLAY
	---help---
	  Select the number of video overlays which can be used as framebuffers.
	  The remaining overlays are reserved for video.

config DRM_OMAP_DMM_TILER
	tristate "OMAP DMM TILER"
	default y
	---help---
	  DMM Tiler driver for OMAP4+ boards

endif
```
